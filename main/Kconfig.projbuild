## main/Kconfig.projbuild
```kconfig
menu "way2.net ESP Logger Configuration"

    config PRODUCT_NAME
        string "Product Name"
        default "ESPLogger"
        help
            Specify how your product should be called

    config BOOTSTRAP_GPIO
        int "Bootstrap GPIO number"
        range 0 39
        default 35
        help
            GPIO number (IOxx) to put the device into AP configuration mode. H = enter config


    config INFOLED_GPIO
        int "Info LED GPIO number"
        range 0 39
        default 2
        help
            GPIO number (IOxx) where the LED is connected to. 
            
            
endmenu
```
